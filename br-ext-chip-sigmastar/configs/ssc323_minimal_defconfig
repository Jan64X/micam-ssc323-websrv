## br-ext-chip-sigmastar/configs/ssc323_minimal_defconfig
```kconfig
# Architecture
BR2_arm=y
BR2_cortex_a7=y
BR2_ARM_EABIHF=y
BR2_ARM_FPU_NEON_VFPV4=y
BR2_ARM_INSTRUCTIONS_THUMB2=y
BR2_KERNEL_HEADERS_VERSION=y
BR2_DEFAULT_KERNEL_VERSION="4.9.84"
BR2_PACKAGE_HOST_LINUX_HEADERS_CUSTOM_4_9=y

# Toolchain
BR2_PER_PACKAGE_DIRECTORIES=y
BR2_GCC_VERSION_13_X=y
BR2_TOOLCHAIN_USES_MUSL=y
BR2_TOOLCHAIN_BUILDROOT_MUSL=y
BR2_TOOLCHAIN_BUILDROOT_LIBC="musl"
# BR2_TOOLCHAIN_BUILDROOT_CXX is not set
# BR2_TOOLCHAIN_BUILDROOT_LOCALE is not set
BR2_TOOLCHAIN_BUILDROOT_USE_SSP=y

# Kernel
BR2_LINUX_KERNEL=y
BR2_LINUX_KERNEL_CUSTOM_TARBALL=y
BR2_LINUX_KERNEL_CUSTOM_TARBALL_LOCATION="https://github.com/openipc/linux/archive/$(OPENIPC_KERNEL).tar.gz"
BR2_LINUX_KERNEL_USE_CUSTOM_CONFIG=y
BR2_LINUX_KERNEL_CUSTOM_CONFIG_FILE="$(EXTERNAL_VENDOR)/board/$(OPENIPC_SOC_FAMILY)/kernel/infinity6-ssc009a.config"
BR2_LINUX_KERNEL_UIMAGE=y
BR2_LINUX_KERNEL_XZ=y

# OpenIPC
BR2_OPENIPC_SOC_VENDOR="sigmastar"
BR2_OPENIPC_SOC_MODEL="ssc323"
BR2_OPENIPC_SOC_FAMILY="infinity6"
BR2_OPENIPC_VARIANT="minimal"
BR2_OPENIPC_FLASH_SIZE="8"

# Filesystem
# BR2_TARGET_TZ_INFO is not set
BR2_TARGET_ROOTFS_CPIO=y
BR2_TARGET_ROOTFS_SQUASHFS=y
BR2_TARGET_ROOTFS_SQUASHFS4_XZ=y
BR2_ROOTFS_OVERLAY="$(BR2_EXTERNAL)/overlay $(EXTERNAL_VENDOR)/overlay-minimal"
BR2_ROOTFS_POST_BUILD_SCRIPT="$(BR2_EXTERNAL)/scripts/rootfs_script.sh"

# OpenIPC configuration
BR2_TOOLCHAIN_BUILDROOT_VENDOR="openipc"
BR2_TARGET_GENERIC_ISSUE="Welcome to SSC323"
BR2_TARGET_GENERIC_HOSTNAME="ssc323"
BR2_GLOBAL_PATCH_DIR="$(BR2_EXTERNAL)/package/all-patches"

# Core packages only
BR2_PACKAGE_BUSYBOX_CONFIG="$(BR2_EXTERNAL)/package/busybox/busybox.config"
BR2_PACKAGE_DROPBEAR_OPENIPC=y
# BR2_PACKAGE_IFUPDOWN_SCRIPTS is not set
BR2_PACKAGE_UBOOT_TOOLS=y

# Wireless - MT7601U WiFi dongle
BR2_PACKAGE_WIRELESS_TOOLS=y
BR2_PACKAGE_WPA_SUPPLICANT=y
BR2_PACKAGE_WPA_SUPPLICANT_CLI=y
BR2_PACKAGE_WPA_SUPPLICANT_NL80211=y
BR2_PACKAGE_WPA_SUPPLICANT_PASSPHRASE=y
BR2_PACKAGE_LINUX_FIRMWARE_OPENIPC=y
BR2_PACKAGE_LINUX_FIRMWARE_OPENIPC_MEDIATEK_MT7601U=y
BR2_PACKAGE_MT7601U_OPENIPC=y

# Explicitly disabled - camera/streaming stuff not needed
# BR2_PACKAGE_MAJESTIC is not set
# BR2_PACKAGE_MAJESTIC_FONTS is not set
# BR2_PACKAGE_MAJESTIC_WEBUI is not set
# BR2_PACKAGE_SIGMASTAR_OSDRV_INFINITY6 is not set
# BR2_PACKAGE_OPUS_OPENIPC is not set
# BR2_PACKAGE_LIBOGG_OPENIPC is not set
# BR2_PACKAGE_LIBEVENT_OPENIPC is not set
# BR2_PACKAGE_LIBCURL_OPENIPC is not set
# BR2_PACKAGE_MBEDTLS_OPENIPC is not set
# BR2_PACKAGE_JSON_C is not set
# BR2_PACKAGE_JSONFILTER is not set
# BR2_PACKAGE_LIBYAML is not set
# BR2_PACKAGE_YAML_CLI is not set
# BR2_PACKAGE_IPCTOOL is not set
# BR2_PACKAGE_VTUND_OPENIPC is not set
# BR2_PACKAGE_EXFAT_OPENIPC is not set
# BR2_PACKAGE_EXFATPROGS is not set
# BR2_PACKAGE_FDK_AAC_OPENIPC is not set
# BR2_PACKAGE_MINI_SNMPD is not set
# BR2_PACKAGE_MOTORS is not set
# BR2_PACKAGE_SSHPASS is not set
# BR2_PACKAGE_UACME_OPENIPC is not set
# BR2_PACKAGE_RTL8188EU is not set
# BR2_PACKAGE_RTL8192EU_OPENIPC is not set
# BR2_PACKAGE_HOST_GDB is not set
# BR2_PACKAGE_GDB is not set

# Build optimizations
# BR2_CCACHE is not set
BR2_OPTIMIZE_S=y

# External toolchain (faster builds)
BR2_TOOLCHAIN_EXTERNAL=y
BR2_TOOLCHAIN_EXTERNAL_CUSTOM=y
BR2_TOOLCHAIN_EXTERNAL_CUSTOM_MUSL=y
BR2_TOOLCHAIN_EXTERNAL_CUSTOM_PREFIX="arm-openipc-linux-musleabihf"
BR2_TOOLCHAIN_EXTERNAL_CXX=y
BR2_TOOLCHAIN_EXTERNAL_DOWNLOAD=y
BR2_TOOLCHAIN_EXTERNAL_HEADERS_4_9=y
BR2_TOOLCHAIN_EXTERNAL_URL="https://github.com/openipc/firmware/releases/download/toolchain/toolchain.sigmastar-infinity6.tgz"
```
